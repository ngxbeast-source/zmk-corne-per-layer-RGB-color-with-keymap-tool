/* ---- STEP 1: DEFINE LAYERS ---- */
#define ABC 0
#define NMRW 1
#define FKEYS 2
#define KPAD 3
#define XTRA 4
#define XTR2 5
#define GAME 6
#define GFUN 7
#define GAMETGL 8
#define GAME2 9
#define GAME2_SUBLR1 10
#define TGL 11
#define TGLLR_1 12
#define TGLLR_1_SUBLR_1 13
#define TGLLR_2 14
#define TGLLR_2_SUBLR_1 15

/* ---- STEP 1a: DEFINE COLORS ---- */
#define RGB_ABC         RGB_COLOR_HSB(19,100,17)      /* BASE        - Dim Yellow */
#define RGB_NMRW        RGB_COLOR_HSB(183,45,18)      /* SUB-LAYOUT  - Teal */
#define RGB_KPAD        RGB_COLOR_HSB(230,87,26)      /* SUB-LAYOUT  - Pale Blue */
#define RGB_XTRA        RGB_COLOR_HSB(273,67,23)      /* SUB-LAYOUT  - Light Purple */
#define RGB_GAME        RGB_COLOR_HSB(0,100,25)       /* SUB-BASE    - Red */
#define RGB_GAMETGL     RGB_COLOR_HSB(200,100,60)     /* TOGGLE-LAYER- Cyan*/
#define RGB_GAME2       RGB_COLOR_HSB(73,67,15)       /* SUB-BASE    - Dim Emerald */
#define RGB_GFUN        RGB_COLOR_HSB(116,67,50)      /* SUB-LAYOUT  - Bright Yellow */
#define RGB_XTR2       RGB_COLOR_HSB(116,67,26)      /* SUB-LAYOUT  - Pale Green */
#define RGB_TGL         RGB_COLOR_HSB(251,67,60)      /* TOGGLE-LAYER- Indigo */
#define RGB_TGLLR_1     RGB_COLOR_HSB(40,100,12)      /* SUB-BASE  - Yellow */
#define RGB_TGLLR_2     RGB_COLOR_HSB(85,100,15)      /* SUB-BASE  - Lime */
#define RGB_TGLLR_2_SUBLR_1 RGB_COLOR_HSB(82,100,20) /* SUB-LAYOUT  - Bright Lime */
#define RGB_TGLLR_1_SUBLR_1 RGB_COLOR_HSB(58,45,20) /* SUB-LAYOUT */
#define RGB_GAME2_SUBLR1 RGB_COLOR_HSB(67,55,20)   /* SUB-LAYOUT */

/* ---- (OPTIONAL) BLINK HELPERS ---- */
#define BLINK_ON     RGB_COLOR_HSB(39,100,75)    /* Blink On - Bright Yellow (change to whatever you want, multiple colors can be made like shown below) */
#define N_BLINK_ON   RGB_COLOR_HSB(0,100,60)     /* Num On - Bright Red */
#define C_BLINK_ON   RGB_COLOR_HSB(200,100,60)   /* Caps On - Cyan */

#define F_BLINK_ON   RGB_COLOR_HSB(73,67,60)     /* Functions - Bright Emerald */

#define BLINK_SEQ(ON, OFF, WAIT) \
    &macro_tap &rgb_ug ON \
    &macro_wait_time WAIT \
    &macro_tap &rgb_ug RGB_TOG \
    &macro_wait_time WAIT \
    &macro_tap &rgb_ug RGB_TOG \
    &macro_wait_time WAIT \
    &macro_tap &rgb_ug RGB_TOG \
    &macro_wait_time WAIT \
    &macro_tap &rgb_ug RGB_TOG \
    &macro_wait_time WAIT \
    &macro_tap &rgb_ug OFF
/* ----MACRO HELPERS ---- */
#define MO_RGB(node_name, node_label, layer, active_color, release_color) \
        ZMK_MACRO(node_name, \
            bindings = \
                <&macro_press>, \
                <&mo layer>, \
                <&macro_tap>, \
                <&rgb_ug active_color>, \
                <&macro_pause_for_release>, \
                <&macro_release>, \
                <&mo layer>, \
                <&macro_tap>, \
                <&rgb_ug release_color>; \
            label = node_label; \
        )
#define TO_RGB(node_name, node_label, layer, color) \
        ZMK_MACRO(node_name, \
            bindings = \
                <&macro_tap>, \
                <&to layer>, \
                <&macro_tap>, \
                <&rgb_ug color>; \
            label = node_label; \
        )
#define TO_RGB_PRESS(node_name, node_label, layer, color) \
        ZMK_MACRO(node_name, \
            bindings = \
                <&macro_tap>, \
                <&to layer>, \
                <&macro_press>, \
                <&rgb_ug color>; \
            label = node_label; \
        )   
/* ---- HOLD-TAP BEHAVIOR TEMPLATE ---- */
#define RGB_HT(node_name, node_label, macro_ref) \
        node_name: node_name { \
            compatible = "zmk,behavior-hold-tap"; \
            label = node_label; \
            bindings = <&macro_ref>, <&kp>; \
            #binding-cells = <2>; \
            tapping-term-ms = <200>; \
            flavor = "tap-preferred"; \
            quick-tap-ms = <180>; \
            global-quick-tap; \
        };
/* EXPERIMENTAL: Momentary + Blink helper*/
#define MO_BLINK(node_name, node_label, layer, blink_color, return_color, wait) \
        ZMK_MACRO(node_name, \
            label = node_label; \
            bindings = <&macro_press &mo layer BLINK_SEQ(blink_color, return_color, wait)>, \
                       <&macro_pause_for_release>, \
                       <&macro_release &mo layer>; \
        )
/* EXPERIMENTAL: Blink helper - Hardcode a &kp you want to "blink", used in conjunction with tap-dance*/
#define KP_BLINK(node_name, node_label, key, blink_color, return_color, wait) \
         ZMK_MACRO(node_name, \
            label = node_label; \
            bindings = <&macro_tap &kp key>, \
            <BLINK_SEQ(blink_color, return_color, wait)>; \
        )
/* ---- COMBO HELPER ---- */
#define CMB(name, bind, p1, p2, ...) \
    name { bindings = <bind>; key-positions = <p1 p2>; layers = <__VA_ARGS__>; timeout-ms = <50>; }
 /{
    /* ---- STEP 2+3: MACROS (build macros for all needed behaviors/layers) ---- */
    macros {
        /* Toggled and momentary macros for RGB layers */
        /* Momentary Layers:
             These are bound to a hold-tap behavior for full effect */
        MO_RGB(mo_rgb_xtra2, "xtra2Layer Momentary LED Macro", XTR2, RGB_XTR2, RGB_ABC)
        MO_RGB(mo_rgb_kpad, "KeyPadLayer Momentary LED Macro", KPAD, RGB_KPAD, RGB_ABC)
        MO_RGB(mo_rgb_xtra, "ExtraLayer Momentary LED Macro", XTRA, RGB_XTRA, RGB_ABC)
        MO_RGB(mo_rgb_nmrw, "NumberRowLayer Momentary LED Macro", NMRW, RGB_NMRW, RGB_ABC)
        MO_RGB(mo_rgb_gfun, "GameLayer Sublayer Momentary LED Macro", GFUN, RGB_GFUN, RGB_GAME)
        MO_RGB(mo_rgb_t2_s1, "ToggleLayer2 SubLayer1 Momentary LED Macro", TGLLR_2_SUBLR_1, RGB_TGLLR_2_SUBLR_1, RGB_TGLLR_2)
        MO_RGB(mo_rgb_t1_s1, "ToggleLayer1 Sublayer1 Momentary LED Macro", TGLLR_1_SUBLR_1, RGB_TGLLR_1_SUBLR_1, RGB_TGLLR_1)
        MO_RGB(mo_rgb_g2_s1, "GameLayer2 SubLayer1 Momentary LED Macro", GAME2_SUBLR1, RGB_GAME2_SUBLR1, RGB_GAME2) 

        /* TOGGLED Layers:
                These are bound straight to the keymap, OR to a combo. */
        TO_RGB(to_rgb_default, "Base Layer LED", ABC, RGB_ABC)
        TO_RGB(to_rgb_t1, "ToggleLayer1 LED", TGLLR_1, RGB_TGLLR_1)
        TO_RGB(to_rgb_t2, "ToggleLayer2 LED", TGLLR_2, RGB_TGLLR_2)
        TO_RGB(to_rgb_game, "GameLayer LED Macro", GAME, RGB_GAME)
        
        TO_RGB(to_rgb_g2_s1, "Toggle Game2 SubLayer1 LED", GAME2_SUBLR1, RGB_GAME2_SUBLR1)
        TO_RGB(to_rgb_g2, "Toggle Game2 LED", GAME2, RGB_GAME2)

        //Toggle Layers/Gateways
        TO_RGB_PRESS(top_rgb_toglayers, "ToggleLayer LED", TGL, RGB_TGL)
        TO_RGB_PRESS(top_rgb_gtgl, "gametoggle LED Macro", GAMETGL, RGB_GAMETGL)
    };
    /* ---- (optional) BLINK/STATUS MACROS ---- */
    blnk: blnk {
        compatible = "zmk,behavior-macro-one-param";
        label = "Makes Chosen Keypress 'blink'";
        #binding-cells = <1>;
        wait-ms = <0>;
        tap-ms  = <0>;
        bindings = <
            &macro_param_1to1
            &macro_tap &kp MACRO_PLACEHOLDER
            BLINK_SEQ(BLINK_ON, RGB_XTRA, 80)
        >;
    };
    // EXPERIMENTAL (STANDALONE)
        KP_BLINK(c_blink, "CAPS LOCK + BLINK", CAPS, C_BLINK_ON, RGB_ABC, 80)
        KP_BLINK(n_blink, "NUM LOCK + BLINK", KP_NUMLOCK, N_BLINK_ON, RGB_ABC, 80)

         /* This goes to the "F Keys Layer" (that we layered "on top" of our NumberRowLayer). 
            CAN BE STANDALONE, OR USED WITH RGB_HT TO BIND WITH ANOTHER &kP */ 
        MO_BLINK(f_blink_sa, "F KEYS BLINK; STANDALONE", FKEYS, F_BLINK_ON, RGB_NMRW, 80)


    /* ---- STEP 4: BEHAVIORS - HOLD-TAP ---- */
    behaviors {
        RGB_HT(RGB_ht_nmrw, "RGB HOLD_TAP_NMRW", mo_rgb_nmrw)
        RGB_HT(RGB_ht_xtra2, "RGB HOLD_TAP_XTRA2", mo_rgb_xtra2)
        RGB_HT(RGB_ht_kpad, "RGB HOLD_TAP_KPAD", mo_rgb_kpad)
        RGB_HT(RGB_ht_xtra, "RGB HOLD_TAP_XTRA", mo_rgb_xtra)
        RGB_HT(RGB_ht_gfun, "RGB HOLD_TAP_GFUN", mo_rgb_gfun)
        RGB_HT(RGB_ht_t2_s1, "RGB HOLD_TAP_layer2_sublayer1", mo_rgb_t2_s1)
        RGB_HT(RGB_ht_g2_s1, "RGB HOLD_TAP_GAME2_SUBLAYER1", mo_rgb_g2_s1)
        RGB_HT(RGB_ht_t1_s1, "RGB HOLD_TAP_TOGGLELAYER1_SUBLAYER1", mo_rgb_t1_s1)

        RGB_HT(BLINK_ht_f, "f blink test; &kp BINDABEL", f_blink_sa)

        hm: homerow_mods {
            compatible = "zmk,behavior-hold-tap";
            label = "HOMEROW_MODS";
            #binding-cells = <2>;
            tapping-term-ms = <200>;
            quick_tap_ms = <0>;
            flavor = "tap-preferred";
            bindings = <&kp>, <&kp>;
            quick-tap-ms = <180>;
            global-quick-tap;
        };
        ltq: ltq {
            compatible = "zmk,behavior-hold-tap";
            label = "LTQ";
            bindings = <&mo>, <&kp>;
            #binding-cells = <2>;
            tapping-term-ms = <600>;
            global-quick-tap;
            quick-tap-ms = <400>;
        };
        /* BLINK Tap dance */
        td_numcaps: td_numcapsBLINK {
            compatible = "zmk,behavior-tap-dance";
            #binding-cells = <0>;
            tapping-term-ms = <300>;
            bindings = <&kp LSFT>, <&c_blink>, <&n_blink>;
        };
    };
    /* ---- (OPTIONAL) STEP 5: COMBOS ---- */
    combos {
        compatible = "zmk,combos";
        CMB(left_bkt,   &kp LEFT_BRACKET,   4,  3,  ABC);
        CMB(right_bkt,  &kp RBKT,           7,  8,  ABC);
        CMB(left_par,   &kp LEFT_PARENTHESIS,15,16, ABC);
        CMB(right_par,  &kp RIGHT_PARENTHESIS,19,20, ABC);
        CMB(left_brace, &kp LEFT_BRACE,     27,28, ABC);
        CMB(right_brace,&kp RIGHT_BRACE,    32,31, ABC);
        CMB(bac,        &kp BACKSLASH,      5, 6, ABC);
        CMB(pipe,       &kp PIPE,           17,18, ABC);

        //Pathing
            // Gateways 
        CMB(toggleLayer, &top_rgb_toglayers,  38,39, ABC TGLLR_1 TGLLR_2);
        CMB(game_toggle, &top_rgb_gtgl,        38,39, GAME GAME2);
            // Sub-Layers to (Sub)Base
        CMB(gameLayer_2_BaseLayer, &to_rgb_default, 0,11, GAME);
        CMB(gameLayer,  &to_rgb_game, 0,11, ABC TGL GAME2);
            // "Exit" Combos; Return to (Sub)Base
        CMB(toggleLayer_2_BaseLayer, &to_rgb_default, 39,38, TGL);
        CMB(game_toggle_2_game, &to_rgb_game, 38,39, GAMETGL);
    };

 };
