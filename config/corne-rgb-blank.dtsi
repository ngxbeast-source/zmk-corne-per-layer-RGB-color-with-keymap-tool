/*
 * Blank Modular RGB Layer Template for ZMK
 *
 * Copy this file and fill in your own layers, colors, macros, and behaviors.
 * All sections are commented for easy customization.
 * You can remove any/all comments if you wish, to save space on your firmware.
 // The comments  // or /*...*/ 
 // are just meant to be a guideline for "newbies", they aren't needed.
 // WHEN YOU SEE "UNCOMMENT //, OR /*...*/ TO USE", ONLY DELETE THE SYMBOLS /, /**/ IN THE GIVEN Lines
 // WHEN YOU SEE: 

                /* -------------------REMOVE & BUILD/DEFINE HERE------------------- */

 /* DELETE THE WHOLE LINE AND START YOUR BUILD IN THE SAME LINE. THIS PUTS YOUR CODE "IN" THE DEVICETREE.
 * DONT! DELETE };, {, >;, ) SYMBOLS!
 * REFER TO THE ORIGINAL .dtsi FOR REFERENCE
 * VIEW THIS IN VSCODE IN THE DEVICETREE LANGUAGE MODE FOR BETTER READABILITY
 * IF NEEDED refer to the "completed" corne-rgb.dtsi for reference. 
 */

/* ---- STEP 1: DEFINE LAYERS ---- */
// Example: #define LAYER_BASE 0
// #define L_FN 1
// #define ADJUST 2
                /* -------------------REMOVE & DEFINE HERE------------------- */


/* ---- STEP 1a: DEFINE COLORS ---- */
// Example: #define RGB_BASE   RGB_COLOR_HSB(0,0,20)   // Dim White
// #define RGB_FN     RGB_COLOR_HSB(200,100,60) // Cyan
                /* -------------------REMOVE & DEFINE HERE------------------- */


            /* -------------------DEFINE ENDS; BUILD CONTINUES AT LINE 131------------------- */
/* USE THE HELPERS FOR REFERENCE TO BUILD YOUR MACROS AND/OR BEHAVIORS. NOTHING HAS TO BE CHANGED HERE */
/* ---- (OPTIONAL) BLINK HELPERS ---- */
// "flashes" LEDs a chosen color twice, blink speed can be adjusted with the "wait" modifier.
// UNCOMMENT /*...*/ (Lines 41 & 71) TO USE. "BLINK" macros won't work without this.  

// Multiple Color definitions can be made as needed. Names are arbitary as long as the name relates to the the color make it whatever you want. 
/* #define BLINK_ON     RGB_COLOR_HSB(39,100,75) // BLINK Color
 #define BLINK_OFF    RGB_COLOR_HSB(273,67,23) // Return Color
 #define BLINK_SEQ(ON, OFF, WAIT) \
     &macro_tap &rgb_ug ON \
     &macro_wait_time WAIT \
     &macro_tap &rgb_ug RGB_TOG \
     &macro_wait_time WAIT \
     &macro_tap &rgb_ug RGB_TOG \
     &macro_wait_time WAIT \
     &macro_tap &rgb_ug RGB_TOG \
     &macro_wait_time WAIT \
     &macro_tap &rgb_ug RGB_TOG \
     &macro_wait_time WAIT \
     &macro_tap &rgb_ug OFF 

// EXPERIMENTAL: Momentary + Blink helper (use with RGB_HT) 
#define MO_BLINK(node_name, node_label, layer, blink_color, return_color, wait) \
        ZMK_MACRO(node_name, \
            label = node_label; \
            bindings = <&macro_press &mo layer BLINK_SEQ(blink_color, return_color, wait)>, \
                       <&macro_pause_for_release>, \
                       <&macro_release &mo layer>; \
        )
// EXPERIMENTAL: Blink helper - Hardcode a &kp you want to "blink", used in conjunction with tap-dance
// USED FOR NUM/CAPSLOCK BLINK BEHAVIOR, COLORS NEED TO HARDCODED TO THE &kp IN A MACRO THEN WE CAN MOVE IT TO TAP-DANCE.
#define KP_BLINK(node_name, node_label, key, blink_color, return_color, wait) \
         ZMK_MACRO(node_name, \
            label = node_label; \
            bindings = <&macro_tap &kp key>, \ 
            <BLINK_SEQ(blink_color, return_color, wait)>; \
        ) */

/* ---- MACRO HELPERS ---- */
#define MO_RGB_MACRO(node_name, node_label, layer, active_color, release_color) \
        ZMK_MACRO(node_name, \
            bindings = \
                <&macro_press>, \
                <&mo layer>, \
                <&macro_tap>, \
                <&rgb_ug active_color>, \
                <&macro_pause_for_release>, \
                <&macro_release>, \
                <&mo layer>, \
                <&macro_tap>, \
                <&rgb_ug release_color>; \
            label = node_label; \
        )

#define TO_RGB_MACRO(node_name, node_label, layer, color) \
        ZMK_MACRO(node_name, \
            bindings = \
                <&macro_tap>, \
                <&to layer>, \
                <&macro_tap>, \
                <&rgb_ug color>; \
            label = node_label; \
        )

#define TO_RGB_PRESS_MACRO(node_name, node_label, layer, color) \
        ZMK_MACRO(node_name, \
            bindings = \
                <&macro_tap>, \
                <&to layer>, \
                <&macro_press>, \
                <&rgb_ug color>; \
            label = node_label; \
        )

/* ---- HOLD-TAP BEHAVIOR HELPER---- */
#define RGB_HT(node_name, node_label, macro_ref) \
        node_name: node_name { \
            compatible = "zmk,behavior-hold-tap"; \
            label = node_label; \
            bindings = <&macro_ref>, <&kp>; \
            #binding-cells = <2>; \
            tapping-term-ms = <200>; \
            flavor = "tap-preferred"; \
            quick-tap-ms = <180>; \
            global-quick-tap; \
        };

/* ---- COMBO HELPER ---- */
#define CMB(name, bind, ..., ...) \
    name { bindings = <bind>; key-positions = <__VA_ARGS__>; layers = <__VA_ARGS__>; timeout-ms = <50>; }





                /* -------------------END of DEFINES------------------- */

                /* -------------------vvvMACRO BUILD STARTvvv------------------- */





    /* ---- STEP 2+3: MACROS (define your macros for each layer/behavior) ---- */
/ {
    macros {
    /* ---- (OPTIONAL) BLINK/STATUS MACROS ---- 
     * UNCOMMENT (lines 143 & 158) IF YOU WANT TO USE. COLORS AND LAYERS MUST BE ASSIGNED IN THE DEFINE SECTION*/
/*  // "Unviversal BLINK" can be bound to any key in ZMK.Studio (EXPERIMENTAL, assigned key will "blink")
    blnk: blnk {
        compatible = "zmk,behavior-macro-one-param";
        label = "Makes Chosen Keypress 'blink'";
        #binding-cells = <1>;
        wait-ms = <0>;
        tap-ms  = <0>;
        bindings = <
            &macro_param_1to1
            &macro_tap &kp MACRO_PLACEHOLDER
            BLINK_SEQ(BLINK_ON, BLINK_OFF, 80)
        >;
    }; 
    // EXPERIMENTAL TAP-DANCE BLINK(STANDALONE)
    KP_BLINK(c_blink, "CAPS LOCK + BLINK", CAPS, C_BLINK_ON, RGB_ABC, 80)
    KP_BLINK(n_blink, "NUM LOCK + BLINK", KP_NUMLOCK, N_BLINK_ON, RGB_ABC, 80) */

                /* -------------------REMOVE & BUILD HERE------------------- */



    /* ---- STEP 4: BEHAVIORS - HOLD-TAP ---- */
/* Build behaviors for momentary layers here, using the macros you built above */
    behaviors {
    /* ---- (OPTIONAL) Tap dance ---- */
    /* Define tap dance behaviors here if needed
        //UNCOMMENT (lines 171 & 176) TO USE 
        //TAP DANCE FOR SHIFT CAPS AND NUMLOCK; DIFFERENT COLOR BLINK FOR WHEN EACH IS TOGGLED.
/*        td_numcaps: td_numcapsBLINK {
        compatible = "zmk,behavior-tap-dance";
        #binding-cells = <0>;
        tapping-term-ms = <300>;
        bindings = <&kp LSFT>, <&c_blink>, <&n_blink>;
    }; */
        // Example:
        // RGB_HOLD_TAP(hold_tap_fn, "HOLD_TAP_FN", fn_led)
                /* -------------------REMOVE & BUILD HERE------------------- */

    };

    /* ---- STEP 5: COMBOS - ACCESSING/LEAVING OUR ToggleLayer  ---- */
    combos {
        compatible = "zmk,combos";
        // Example:
        // COMBO(my_combo, &kp ESC, 0, 1, LAYER_BASE)
                /* -------------------REMOVE & BUILD HERE------------------- */
    };
};
                /* -------------------.DTSI BUILD END------------------- */

