## config/west.yml
```yaml
manifest:
  remotes:
    - name: zmkfirmware
      url-base: https://github.com/zmkfirmware
    - name: petejohanson
      url-base: https://github.com/petejohanson
    - name: mctechnology17
      url-base: https://github.com/mctechnology17


    - name: zmk
      remote: zmkfirmware
      revision: v0.3
      import: app/west.yml

    - name: zmk-nice-oled
      remote: mctechnology17
      revision: main

  self:
    path: config
```
